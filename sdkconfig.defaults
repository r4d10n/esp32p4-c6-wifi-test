## sdkconfig.defaults
```kconfig
# Target: ESP32-P4
CONFIG_IDF_TARGET="esp32p4"

# PSRAM (32MB hex mode on Waveshare ESP32-P4-WIFI6)
CONFIG_SPIRAM=y
CONFIG_SPIRAM_MODE_HEX=y
CONFIG_SPIRAM_SPEED_200M=y

# Flash size (32MB available, use 4MB for partition layout)
CONFIG_ESPTOOLPY_FLASHSIZE_8MB=y

# Custom partition table (factory + slave_fw for OTA)
CONFIG_PARTITION_TABLE_CUSTOM=y
CONFIG_PARTITION_TABLE_CUSTOM_FILENAME="partitions.csv"

# Performance
CONFIG_COMPILER_OPTIMIZATION_PERF=y
CONFIG_IDF_EXPERIMENTAL_FEATURES=y

# FreeRTOS
CONFIG_FREERTOS_HZ=1000

# WiFi via esp_wifi_remote + esp-hosted (remote WiFi on ESP32-C6)
# ESP_WIFI_REMOTE_LIBRARY_HOSTED enables the esp-hosted backend
# ESP_HOSTED_ENABLED is auto-set by Kconfig dependencies
CONFIG_ESP_WIFI_REMOTE_LIBRARY_HOSTED=y

# ESP-Hosted SDIO transport (Waveshare ESP32-P4-WIFI6 board)
CONFIG_ESP_HOSTED_SDIO_HOST_INTERFACE=y
CONFIG_ESP_HOSTED_SDIO_CLOCK_FREQ_KHZ=40000
CONFIG_ESP_HOSTED_SDIO_BUS_WIDTH=4
CONFIG_ESP_HOSTED_SDIO_TX_Q_SIZE=60
CONFIG_ESP_HOSTED_SDIO_RX_Q_SIZE=60

# Disable watchdogs for testing
CONFIG_ESP_INT_WDT=n
CONFIG_ESP_TASK_WDT_EN=n

# NVS
CONFIG_NVS_ENCRYPTION=n

# Log level
CONFIG_LOG_DEFAULT_LEVEL_INFO=y
CONFIG_LOG_MAXIMUM_LEVEL_VERBOSE=y

# WiFi raw packet injection/monitoring (CustomRpc)
CONFIG_ESP_HOSTED_ENABLE_PEER_DATA_TRANSFER=y
CONFIG_ESP_HOSTED_MAX_CUSTOM_MSG_HANDLERS=8

# ============================================================
# PERFORMANCE OPTIMIZATION - lwIP & WiFi
# See docs/lwip-optimization-study.md for detailed analysis
# ============================================================

# --- TCP Window & Buffers (CRITICAL) ---
# Default 5760 caps TCP at ~15 Mbps. 65534 removes the ceiling.
CONFIG_LWIP_TCP_SND_BUF_DEFAULT=65534
CONFIG_LWIP_TCP_WND_DEFAULT=65534
CONFIG_LWIP_TCP_RECVMBOX_SIZE=64
CONFIG_LWIP_UDP_RECVMBOX_SIZE=64
CONFIG_LWIP_TCPIP_RECVMBOX_SIZE=64

# --- WiFi A-MPDU (HIGH) ---
# BA window 6->32: 5.3x more frames in-flight
CONFIG_WIFI_RMT_TX_BA_WIN=32
CONFIG_WIFI_RMT_RX_BA_WIN=32
CONFIG_WIFI_RMT_STATIC_RX_BUFFER_NUM=32
CONFIG_WIFI_RMT_DYNAMIC_RX_BUFFER_NUM=64
CONFIG_WIFI_RMT_DYNAMIC_TX_BUFFER_NUM=64

# --- lwIP IRAM (HIGH) ---
# Move packet processing hot path to IRAM (~27 KB)
CONFIG_LWIP_IRAM_OPTIMIZATION=y
CONFIG_LWIP_EXTRA_IRAM_OPTIMIZATION=y

# --- TCP Algorithms (MEDIUM) ---
CONFIG_LWIP_TCP_SACK_OUT=y
CONFIG_LWIP_TCP_OOSEQ_MAX_PBUFS=8
CONFIG_LWIP_TCP_RTO_TIME=300

# --- Task Scheduling (MEDIUM) ---
# Pin lwIP to core 1 (core 0 handles SDIO/WiFi driver)
CONFIG_LWIP_TCPIP_TASK_AFFINITY_CPU1=y
CONFIG_LWIP_TCPIP_TASK_STACK_SIZE=4096
CONFIG_LWIP_TCPIP_CORE_LOCKING=y
```
